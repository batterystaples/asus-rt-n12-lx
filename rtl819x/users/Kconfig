## rtl819x/users/Kconfig
```kconfig
#############################################################################

#
#	Kconfig - user applications and library configuration
#

#############################################################################

comment "Applications"

config APP_AUTH
	bool "auth"
	help
	  A daemon used for Wireless EAP.

config APP_BRCTL
	bool "brctl"
	help
	  Brctl is used to set up, maintain, and inspect the ethernet bridge 
	  configuration in the linux kernel.


config APP_BUSYBOX
	bool "busybox"
	help
	  BusyBox combines tiny versions of many common UNIX utilities into
	  a single small executable.  It provides minimalist replacements
	  for most of the utilities you usually find in fileutils, shellutils,
	  findutils, textutils, grep, gzip, tar, etc.  Simply select those
	  utilities and options you want.

config APP_CTORRENT
	bool "Enhanced Ctorrent"
	help
	  Enhanced Ctorrent is a light-weight BT Client on UNIX like OS.

config APP_DCTS
	bool "dcts"
	help
	  dcts is a controller server for Enhanced Ctorrent

config APP_DHCPV6
	bool "dhcpv6"
	help
	  Dhcp daemon for Ipv6.

config APP_DISCOVER
	bool  "discover"
	help
	  Auto Discovery Server

config APP_DNRD
	bool "dnrd"
	help 
	  dns relay for ipv4

config APP_DNSMASQ
	bool "dnsmasq"
	default n
	help
	  dns proxy for IPv4 and IPv6

config APP_DOSFSCK
        bool "dosfsck"
        help
          A tool to check dos file system.

config APP_GDBSERVER
        bool "gdbserver"
        help
          The gdbserver-6.8 for debug application

config APP_GOAHEAD
	bool "goahead"
	help
	  A simple HTTPD Daemon. It provides web interface of the Wireless Gateway

config APP_GPROXY
	bool "gproxy"
	help
	  The gproxy daemon

config APP_IAPP
	bool "iapp"
	help
          The IAPP application

config APP_IGMPPROXY
	bool "igmp proxy"
	help
	  The igmp proxy daemon

config IGMPV3_SUPPORT
	depends on APP_IGMPPROXY
	bool "support igmpv3 proxy"
	   			 
config APP_IPROUTE
	bool "iproute2"
	help
	  The iproute2 daemon

config APP_IPTABLES
	bool "iptables"
	help
	  The iptables daemon

config APP_IWCONTROL
	bool "iwcontrol"
	help
	  The iwcontrol utility.

config APP_L2TPD
	bool "l2tpd"
	help
	  A l2tpd daemon.

config APP_LLTDD
	bool "lltdd"
	help
	  The Link Layer Topology Discovery (LLTD) daemon.

config APP_MINI_UPNP
	bool "mini_upnp"
	help
	  A Mini-UPNP Daemon and library for miniigd and wsc.

config APP_MINIIGD
	bool "miniigd"
	help
	  A miniigd daemon.

config APP_MKDOSFS
        bool "mkdosfs"
        help
          A tool to make dos file system.

config APP_MP
        bool "mp daemon"
        help
          A mp daemon.

config APP_NTFS3G
	bool "ntfs3g"
	help
	  NT file system support

config APP_NTPCLIENT
	bool "ntpclient"
	help
	  The ntpclient daemon

config APP_OPENSSL
	bool "openssl"
	help
	  The openssl tool.
	default n

config APP_HOSTAPD_HCM
	bool "hostapd in host controlled mode"
	depends on APP_OPENSSL
	help
	  The hostap daemon is patched based on 0.6.10

config APP_WAPI
	bool "wapi_utils"
	depends on APP_OPENSSL
	help
	  The wapi certs related applications.
	default n

config APP_ORAYDDNS
	bool "oray ddns"
	help
	  The oray ddns daemon

config APP_PATHSEL
	bool "pathsel"
	help
	  The mesh path selection paemon

config APP_PPPD
	bool "pppd"
	help
	  A ppp daemon.
 
config APP_PPTP
	bool "pptp"
	help
	  A pptp client.

config APP_RADVD
	bool "radvd"
	help
	  radvd daemon for Ipv6.

config APP_RELOAD
	bool "reload"
	help
	  Reload configuration at the end of init.

config APP_ROUTED
	bool "routed"
	help
	   RIP daemon for dynamic routing

config APP_SAMBA
	bool "samba"
	help
	  The samba daemon.

config APP_SCRIPT
	bool "scripts"
	help
	  The scripts used to init the gw and start the daemons

config APP_SQUASHFS40
	bool "squashfs 4.0"
	help
	  squashfs tools to build image 
 
config APP_UDHCPD
	bool "udhcp" 
	help
	  An embedded DHCP client and server	

config APP_UPDATEDD
	bool "updatedd DDNS"
	help
	  An DDNS daemon for serverl DDNS ISP

config APP_USBMOUNT
	bool "usbmount"
	help
	  The usbmount daemon.

config APP_WIRELESSTOOLS
	bool "wireless tools"
	help
	  The wireless tools

config APP_WSC
	bool "wsc daemon"
	select APP_MINI_UPNP
	help
	  The wireless WPS daemon
 
config APP_HOSTAPD
	bool "hostapd"
	help
	  The hostap daemon in vserion 0.6.9


config APP_HOSTAPD_SLAVE
        bool "hostapd_slave"
        help
          The hostap_slave daemon in support vserion 0.6.10
	
config APP_NFBI
	bool "nfbi"
	help
	  User space program for NFBI.
	  
comment "USB3G support"
config APP_COMGT
	bool "comgt"
	help
	  GSM dialup script.

config APP_CHAT
	bool "chat"
	help
	  PPP chat.

config APP_LIBUSB
 	bool "libusb"
 	help
 	  libusb.

config APP_USBMODESWITCH
	bool "usb-modeswitch"
	help
	  usb-modeswitch.

config APP_MBPK_EJECT
	bool "mbpk_eject"
	help
	  mbpk_eject.

config APP_USBMODESWITCH_DATA
	bool "usb-modeswitch-data"
	help
	  usb-modeswitch-data.

config APP_USBUTILS
	bool "usbutils"
	help
	  usbutils.

config APP_HUBCTRL
	bool "hub-ctrl"
	help
	  hub-ctrl.

config APP_MNET
	bool "mnet"
	help
	  mnet.

comment "Libraries"

config LIB_PNG
    bool "libpng"
    select LIB_Z
	help
	  A small example library, only for demostration.

config LIB_Z
    bool "zlib"
	help
	  A small example library, only for demostration.

config LIB_NL
    depends on APP_HOSTAPD
    bool "libnl-1.1"
	help
	  library requried by hostapd-0.6.9

config APP_FLEX
	bool "flex library"
	help
	  flex library.

comment "Debug & Test"

config APP_CLE_SHELL
	bool "cle_shell"
	help
	  for debug and IC test.

config APP_UTILS
	bool "utils"
	help
	  A set of useful utilities for debug and IC test.

config APP_IPERF
	bool "iperf"
	help
	  A modern tool for network performance measurement.

config APP_DHRYSTONE
	bool "dhrystone"
	help
	  A small example, only for demostration.

config APP_IOZONE
	bool "iozone"
	help 
	  A filesystem benchmark tool

config APP_LTP
	bool "ltp"
	help 
	  Linux Test Project

config APP_EXAMPLE
	bool "example"
	help
	  A small example, only for demostration.

config APP_RELOAD
	bool "reload"
	help
	  A periodly checking utility

config APP_DLNA_DMS
	bool "dlna_dms"
	help
	 ushare daemon
#############################################################################
```
